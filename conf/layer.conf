## conf/layer.conf
```bitbake
# We have a conf and classes directory, add to BBPATH
BBPATH .= ":${LAYERDIR}"

# We have recipes-* directories, add to BBFILES
BBFILES += "${LAYERDIR}/recipes-*/*/*.bb \
            ${LAYERDIR}/recipes-*/*/*.bbappend"

BBFILE_COLLECTIONS += "meta-pino"
BBFILE_PATTERN_meta-pino = "^${LAYERDIR}/"
BBFILE_PRIORITY_meta-pino = "6"

LAYERDEPENDS_meta-pino = "core"
LAYERSERIES_COMPAT_meta-pino = "dunfell"
```
